## config/boards/arm/S60/Kconfig.board
```kconfig
# Copyright (c) 2023 LAZYDESIGNERS
# SPDX-License-Identifier: MIT

config BOARD_S60
	bool "S60"
	depends on SOC_NRF52840_QIAA
```

## config/boards/arm/S60/Kconfig.defconfig
```kconfig
# Copyright (c) 2023 LAZYDESIGNERS
# SPDX-License-Identifier: MIT

if BOARD_S60

config ZMK_KEYBOARD_NAME
	default "S60"

if USB_DEVICE_STACK

config USB_NRFX
	default y

endif # USB_DEVICE_STACK

config BT_CTLR
	default BT

config ZMK_BLE
	default y

config ZMK_USB
	default y

endif # BOARD_S60
```
